## projects/CapGPS/main/Kconfig
```kconfig
menu "CapGPS"
    comment "No project-specific Kconfig options for CapGPS yet."
endmenu
```

## projects/ExtBusLED/main/Kconfig
```kconfig
menu "ExtBusLED"
    comment "No project-specific Kconfig options for ExtBusLED."
endmenu
```
